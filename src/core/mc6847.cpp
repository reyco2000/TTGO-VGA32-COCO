/*
 * ============================================================
 *        CoCo 2&3 Emulator for ESP32-TTGO-VGA32-COCO
 *   (C) 2026 Reinaldo Torres / CoCo Byte Club
 *   https://github.com/reyco2000/TTGO-VGA32-COCO
 *   Based on XRoar , co-developed with Claude Code
 *   GPL-3.0-or-later License
 * ============================================================
 *  File   : mc6847.cpp
 *  Module : MC6847 VDG emulation — scanline rendering to palette index buffer
 * ============================================================
*/

#include "mc6847.h"
#include "../utils/debug.h"
#include "../../config.h"

// MC6847 internal character ROM (64 chars × 12 rows)
// Index: font_6847[(charCode & 0x3F) * 12 + row]
// Each byte: bits 5..0 = pixel data (left to right)
static const uint8_t font_6847_flash[768] PROGMEM = {
    // 0x00 '@'
    0x00, 0x00, 0x00, 0x1c, 0x22, 0x02, 0x1a, 0x2a, 0x2a, 0x1c, 0x00, 0x00,
    // 0x01 'A'
    0x00, 0x00, 0x00, 0x08, 0x14, 0x22, 0x22, 0x3e, 0x22, 0x22, 0x00, 0x00,
    // 0x02 'B'
    0x00, 0x00, 0x00, 0x3c, 0x12, 0x12, 0x1c, 0x12, 0x12, 0x3c, 0x00, 0x00,
    // 0x03 'C'
    0x00, 0x00, 0x00, 0x1c, 0x22, 0x20, 0x20, 0x20, 0x22, 0x1c, 0x00, 0x00,
    // 0x04 'D'
    0x00, 0x00, 0x00, 0x3c, 0x12, 0x12, 0x12, 0x12, 0x12, 0x3c, 0x00, 0x00,
    // 0x05 'E'
    0x00, 0x00, 0x00, 0x3e, 0x20, 0x20, 0x3c, 0x20, 0x20, 0x3e, 0x00, 0x00,
    // 0x06 'F'
    0x00, 0x00, 0x00, 0x3e, 0x20, 0x20, 0x3c, 0x20, 0x20, 0x20, 0x00, 0x00,
    // 0x07 'G'
    0x00, 0x00, 0x00, 0x1e, 0x20, 0x20, 0x26, 0x22, 0x22, 0x1e, 0x00, 0x00,
    // 0x08 'H'
    0x00, 0x00, 0x00, 0x22, 0x22, 0x22, 0x3e, 0x22, 0x22, 0x22, 0x00, 0x00,
    // 0x09 'I'
    0x00, 0x00, 0x00, 0x1c, 0x08, 0x08, 0x08, 0x08, 0x08, 0x1c, 0x00, 0x00,
    // 0x0A 'J'
    0x00, 0x00, 0x00, 0x02, 0x02, 0x02, 0x02, 0x22, 0x22, 0x1c, 0x00, 0x00,
    // 0x0B 'K'
    0x00, 0x00, 0x00, 0x22, 0x24, 0x28, 0x30, 0x28, 0x24, 0x22, 0x00, 0x00,
    // 0x0C 'L'
    0x00, 0x00, 0x00, 0x20, 0x20, 0x20, 0x20, 0x20, 0x20, 0x3e, 0x00, 0x00,
    // 0x0D 'M'
    0x00, 0x00, 0x00, 0x22, 0x36, 0x2a, 0x2a, 0x22, 0x22, 0x22, 0x00, 0x00,
    // 0x0E 'N'
    0x00, 0x00, 0x00, 0x22, 0x32, 0x2a, 0x26, 0x22, 0x22, 0x22, 0x00, 0x00,
    // 0x0F 'O'
    0x00, 0x00, 0x00, 0x3e, 0x22, 0x22, 0x22, 0x22, 0x22, 0x3e, 0x00, 0x00,
    // 0x10 'P'
    0x00, 0x00, 0x00, 0x3c, 0x22, 0x22, 0x3c, 0x20, 0x20, 0x20, 0x00, 0x00,
    // 0x11 'Q'
    0x00, 0x00, 0x00, 0x1c, 0x22, 0x22, 0x22, 0x2a, 0x24, 0x1a, 0x00, 0x00,
    // 0x12 'R'
    0x00, 0x00, 0x00, 0x3c, 0x22, 0x22, 0x3c, 0x28, 0x24, 0x22, 0x00, 0x00,
    // 0x13 'S'
    0x00, 0x00, 0x00, 0x1c, 0x22, 0x10, 0x08, 0x04, 0x22, 0x1c, 0x00, 0x00,
    // 0x14 'T'
    0x00, 0x00, 0x00, 0x3e, 0x08, 0x08, 0x08, 0x08, 0x08, 0x08, 0x00, 0x00,
    // 0x15 'U'
    0x00, 0x00, 0x00, 0x22, 0x22, 0x22, 0x22, 0x22, 0x22, 0x1c, 0x00, 0x00,
    // 0x16 'V'
    0x00, 0x00, 0x00, 0x22, 0x22, 0x22, 0x14, 0x14, 0x08, 0x08, 0x00, 0x00,
    // 0x17 'W'
    0x00, 0x00, 0x00, 0x22, 0x22, 0x22, 0x2a, 0x2a, 0x36, 0x22, 0x00, 0x00,
    // 0x18 'X'
    0x00, 0x00, 0x00, 0x22, 0x22, 0x14, 0x08, 0x14, 0x22, 0x22, 0x00, 0x00,
    // 0x19 'Y'
    0x00, 0x00, 0x00, 0x22, 0x22, 0x14, 0x08, 0x08, 0x08, 0x08, 0x00, 0x00,
    // 0x1A 'Z'
    0x00, 0x00, 0x00, 0x3e, 0x02, 0x04, 0x08, 0x10, 0x20, 0x3e, 0x00, 0x00,
    // 0x1B '['
    0x00, 0x00, 0x00, 0x38, 0x20, 0x20, 0x20, 0x20, 0x20, 0x38, 0x00, 0x00,
    // 0x1C '\'
    0x00, 0x00, 0x00, 0x20, 0x20, 0x10, 0x08, 0x04, 0x02, 0x02, 0x00, 0x00,
    // 0x1D ']'
    0x00, 0x00, 0x00, 0x0e, 0x02, 0x02, 0x02, 0x02, 0x02, 0x0e, 0x00, 0x00,
    // 0x1E up-arrow
    0x00, 0x00, 0x00, 0x08, 0x1c, 0x2a, 0x08, 0x08, 0x08, 0x08, 0x00, 0x00,
    // 0x1F left-arrow
    0x00, 0x00, 0x00, 0x00, 0x08, 0x10, 0x3e, 0x10, 0x08, 0x00, 0x00, 0x00,
    // 0x20 SPACE
    0x00, 0x00, 0x00, 0x00, 0x00, 0x00, 0x00, 0x00, 0x00, 0x00, 0x00, 0x00,
    // 0x21 '!'
    0x00, 0x00, 0x00, 0x08, 0x08, 0x08, 0x08, 0x08, 0x00, 0x08, 0x00, 0x00,
    // 0x22 '"'
    0x00, 0x00, 0x00, 0x14, 0x14, 0x14, 0x00, 0x00, 0x00, 0x00, 0x00, 0x00,
    // 0x23 '#'
    0x00, 0x00, 0x00, 0x14, 0x14, 0x36, 0x00, 0x36, 0x14, 0x14, 0x00, 0x00,
    // 0x24 '$'
    0x00, 0x00, 0x00, 0x08, 0x1e, 0x20, 0x1c, 0x02, 0x3c, 0x08, 0x00, 0x00,
    // 0x25 '%'
    0x00, 0x00, 0x00, 0x32, 0x32, 0x04, 0x08, 0x10, 0x26, 0x26, 0x00, 0x00,
    // 0x26 '&'
    0x00, 0x00, 0x00, 0x10, 0x28, 0x28, 0x10, 0x2a, 0x24, 0x1a, 0x00, 0x00,
    // 0x27 '''
    0x00, 0x00, 0x00, 0x18, 0x18, 0x18, 0x00, 0x00, 0x00, 0x00, 0x00, 0x00,
    // 0x28 '('
    0x00, 0x00, 0x00, 0x08, 0x10, 0x20, 0x20, 0x20, 0x10, 0x08, 0x00, 0x00,
    // 0x29 ')'
    0x00, 0x00, 0x00, 0x08, 0x04, 0x02, 0x02, 0x02, 0x04, 0x08, 0x00, 0x00,
    // 0x2A '*'
    0x00, 0x00, 0x00, 0x00, 0x08, 0x1c, 0x3e, 0x1c, 0x08, 0x00, 0x00, 0x00,
    // 0x2B '+'
    0x00, 0x00, 0x00, 0x00, 0x08, 0x08, 0x3e, 0x08, 0x08, 0x00, 0x00, 0x00,
    // 0x2C ','
    0x00, 0x00, 0x00, 0x00, 0x00, 0x00, 0x30, 0x30, 0x10, 0x20, 0x00, 0x00,
    // 0x2D '-'
    0x00, 0x00, 0x00, 0x00, 0x00, 0x00, 0x3e, 0x00, 0x00, 0x00, 0x00, 0x00,
    // 0x2E '.'
    0x00, 0x00, 0x00, 0x00, 0x00, 0x00, 0x00, 0x00, 0x30, 0x30, 0x00, 0x00,
    // 0x2F '/'
    0x00, 0x00, 0x00, 0x02, 0x02, 0x04, 0x08, 0x10, 0x20, 0x20, 0x00, 0x00,
    // 0x30 '0'
    0x00, 0x00, 0x00, 0x18, 0x24, 0x24, 0x24, 0x24, 0x24, 0x18, 0x00, 0x00,
    // 0x31 '1'
    0x00, 0x00, 0x00, 0x08, 0x18, 0x08, 0x08, 0x08, 0x08, 0x1c, 0x00, 0x00,
    // 0x32 '2'
    0x00, 0x00, 0x00, 0x1c, 0x22, 0x02, 0x1c, 0x20, 0x20, 0x3e, 0x00, 0x00,
    // 0x33 '3'
    0x00, 0x00, 0x00, 0x1c, 0x22, 0x02, 0x0c, 0x02, 0x22, 0x1c, 0x00, 0x00,
    // 0x34 '4'
    0x00, 0x00, 0x00, 0x04, 0x0c, 0x14, 0x3e, 0x04, 0x04, 0x04, 0x00, 0x00,
    // 0x35 '5'
    0x00, 0x00, 0x00, 0x3e, 0x20, 0x3c, 0x02, 0x02, 0x22, 0x1c, 0x00, 0x00,
    // 0x36 '6'
    0x00, 0x00, 0x00, 0x1c, 0x20, 0x20, 0x3c, 0x22, 0x22, 0x1c, 0x00, 0x00,
    // 0x37 '7'
    0x00, 0x00, 0x00, 0x3e, 0x02, 0x04, 0x08, 0x10, 0x20, 0x20, 0x00, 0x00,
    // 0x38 '8'
    0x00, 0x00, 0x00, 0x1c, 0x22, 0x22, 0x1c, 0x22, 0x22, 0x1c, 0x00, 0x00,
    // 0x39 '9'
    0x00, 0x00, 0x00, 0x1c, 0x22, 0x22, 0x1e, 0x02, 0x02, 0x1c, 0x00, 0x00,
    // 0x3A ':'
    0x00, 0x00, 0x00, 0x00, 0x18, 0x18, 0x00, 0x18, 0x18, 0x00, 0x00, 0x00,
    // 0x3B ';'
    0x00, 0x00, 0x00, 0x18, 0x18, 0x00, 0x18, 0x18, 0x08, 0x10, 0x00, 0x00,
    // 0x3C '<'
    0x00, 0x00, 0x00, 0x04, 0x08, 0x10, 0x20, 0x10, 0x08, 0x04, 0x00, 0x00,
    // 0x3D '='
    0x00, 0x00, 0x00, 0x00, 0x00, 0x3e, 0x00, 0x3e, 0x00, 0x00, 0x00, 0x00,
    // 0x3E '>'
    0x00, 0x00, 0x00, 0x10, 0x08, 0x04, 0x02, 0x04, 0x08, 0x10, 0x00, 0x00,
    // 0x3F '?'
    0x00, 0x00, 0x00, 0x18, 0x24, 0x04, 0x08, 0x08, 0x00, 0x08, 0x00, 0x00,
};

// DRAM copy of font for fast access (avoids PROGMEM/flash cache latency)
static uint8_t font_6847[768];

void mc6847_init(MC6847* vdg) {
    DEBUG_PRINT("  VDG: MC6847 init");
    memcpy_P(font_6847, font_6847_flash, 768);
    memset(vdg, 0, sizeof(MC6847));
    vdg->vram = NULL;
}

void mc6847_reset(MC6847* vdg) {
    DEBUG_PRINT("  VDG: MC6847 reset");
    vdg->mode = 0;
    vdg->scanline = 0;
    vdg->fs = false;
    vdg->hs = false;
    vdg->vram_offset = 0;
    memset(vdg->line_buffer, 0, sizeof(vdg->line_buffer));
}

void mc6847_set_mode(MC6847* vdg, uint8_t mode) {
    if (mode != vdg->mode) {
        vdg->mode = mode;
        DEBUG_PRINTF("  VDG: mode=0x%02X AG=%d GM=%d CSS=%d",
                     mode,
                     (mode & VDG_AG) ? 1 : 0,
                     mode & 0x07,
                     (mode & VDG_CSS) ? 1 : 0);
    }
}

// ============================================================
// Text mode rendering (AG=0)
// 32x16 characters, each 8 pixels wide × 12 scanlines tall
// VRAM byte: bit 7 = semigraphics flag, bit 6 = inverse, bits 5-0 = char code
// ============================================================

static void render_text_scanline(MC6847* vdg, int scanline) {
    // Text mode uses the SAM base address (not running counter)
    // since text is always 32×16 chars at a fixed location
    const uint8_t* vram = vdg->vram + vdg->vram_offset;
    bool css = (vdg->mode & VDG_CSS) != 0;

    // MC6847 text mode color mapping:
    // VDG "normal" (bit6=0): fg on bg = bright char on dark bg
    // VDG "inverse" (bit6=1): bg on fg = dark char on bright bg
    // CoCo BASIC stores all visible text as VDG "inverse" ($40-$7F),
    // so user sees dark characters on bright (green/orange) background.
    uint8_t fg = css ? VDG_COLOR_ORANGE : VDG_COLOR_GREEN;
    uint8_t bg = css ? VDG_COLOR_BLACK  : VDG_COLOR_BLACK;

    int char_row = scanline / 12;    // 0-15
    int row_line = scanline % 12;    // 0-11 within character cell

    if (char_row >= 16) {
        memset(vdg->line_buffer, bg, VDG_ACTIVE_WIDTH);
        return;
    }

    const uint8_t* row_vram = &vram[char_row * 32];

    for (int col = 0; col < 32; col++) {
        uint8_t ch = row_vram[col];
        int x = col * 8;

        if (ch & 0x80) {
            // Semigraphics-4: bit 7 set
            // bits 6-4 = color (0-7), bits 3-0 = quadrant pixels
            // Top-left=bit3, Top-right=bit2, Bot-left=bit1, Bot-right=bit0
            uint8_t sg_color = (ch >> 4) & 0x07;
            bool top_half = (row_line < 6);
            bool left_pixel, right_pixel;
            if (top_half) {
                left_pixel = (ch & 0x08) != 0;
                right_pixel = (ch & 0x04) != 0;
            } else {
                left_pixel = (ch & 0x02) != 0;
                right_pixel = (ch & 0x01) != 0;
            }
            // Each quadrant is 4 pixels wide
            for (int dx = 0; dx < 4; dx++) {
                vdg->line_buffer[x + dx] = left_pixel ? sg_color : VDG_COLOR_BLACK;
            }
            for (int dx = 4; dx < 8; dx++) {
                vdg->line_buffer[x + dx] = right_pixel ? sg_color : VDG_COLOR_BLACK;
            }
        } else {
            // Normal text character
            bool inv = (ch & 0x40) != 0;
            uint8_t char_code = ch & 0x3F;
            uint8_t bits = font_6847[char_code * 12 + row_line];

            uint8_t on_color  = inv ? bg : fg;
            uint8_t off_color = inv ? fg : bg;

            // Font is 6 pixels wide, centered in 8-pixel cell
            // Pixel 0 = bit 5, pixel 5 = bit 0
            vdg->line_buffer[x + 0] = off_color;  // left padding
            for (int dx = 0; dx < 6; dx++) {
                vdg->line_buffer[x + 1 + dx] = (bits & (0x20 >> dx)) ? on_color : off_color;
            }
            vdg->line_buffer[x + 7] = off_color;  // right padding
        }
    }
}

// ============================================================
// Graphics mode rendering (AG=1)
// GM0-GM2 select resolution and color depth
// ============================================================

// Graphics mode table: GM value -> native width, height, bytes/row, bpp
struct GfxModeInfo {
    uint16_t width;
    uint16_t height;
    uint8_t  bytes_per_row;
    uint8_t  bpp;  // 1 or 2
};

// GM value (0-7) maps to CoCo graphics modes
// GM=0: CG1 (64x64, 2bpp)   GM=1: RG1 (128x64, 1bpp)
// GM=2: CG2 (128x64, 2bpp)  GM=3: RG2 (128x96, 1bpp)
// GM=4: CG3 (128x96, 2bpp)  GM=5: RG3 (128x192, 1bpp)
// GM=6: CG6 (128x192, 2bpp) GM=7: RG6 (256x192, 1bpp)
static const GfxModeInfo gfx_modes[8] = {
    { 64,  64,  16, 2 },  // GM=0: CG1
    { 128, 64,  16, 1 },  // GM=1: RG1
    { 128, 64,  32, 2 },  // GM=2: CG2
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    { 256, 192, 32, 1 },  // GM=7: RG6
};

// 2bpp color sets (4 colors each)
// CSS=0: green, yellow, blue, red
// CSS=1: buff, cyan, magenta, orange
//
// NOTE: On a real CoCo with NTSC composite output, many games (e.g. Zaxxon)
// exploit NTSC artifact coloring — alternating pixel patterns in CG modes
// produce colors through the TV's chroma decoder that differ from the MC6847's
// raw output. Since we render to a digital display (no NTSC artifacts), we map CSS=1
// pixel 0 to BLACK instead of Buff/White. This makes games that use pixel 0
// as "background" display correctly, matching the visual appearance on a real
// CoCo TV (where artifact coloring darkens the base color).
static const uint8_t color_set_0[4] = { VDG_COLOR_GREEN, VDG_COLOR_YELLOW, VDG_COLOR_BLUE, VDG_COLOR_RED };
// NTSC artifact color approximation for digital display:
// On a real CoCo TV, CG CSS=1 pixel pairs produce artifact colors:
//   00 = Black, 01 = Blue, 10 = Orange, 11 = White
static const uint8_t color_set_1[4] = { VDG_COLOR_BLACK, VDG_COLOR_BLUE, VDG_COLOR_ORANGE, VDG_COLOR_WHITE };

// 1bpp color pairs (matches XRoar vdg_palette)
// CSS=0: dark green bg, bright green fg
// CSS=1: dark orange bg, bright orange fg
static void render_graphics_scanline(MC6847* vdg, int scanline) {
    uint8_t gm = vdg->mode & 0x07;
    bool css = (vdg->mode & VDG_CSS) != 0;
    const GfxModeInfo& info = gfx_modes[gm];

    // Use SAM-provided row address instead of computing from scanline.
    // The SAM address counter handles row repetition via divide-by-X/Y.
    const uint8_t* row_data = &vdg->vram[vdg->row_address];

    if (info.bpp == 2) {
        // 2 bits per pixel, 4 colors
        const uint8_t* palette = css ? color_set_1 : color_set_0;
        int scale = 256 / info.width;  // pixels per native pixel

        for (int byte_idx = 0; byte_idx < info.bytes_per_row; byte_idx++) {
            uint8_t b = row_data[byte_idx];
            for (int px = 0; px < 4; px++) {
                uint8_t cidx = (b >> (6 - px * 2)) & 0x03;
                uint8_t color = palette[cidx];
                int x = (byte_idx * 4 + px) * scale;
                for (int s = 0; s < scale; s++) {
                    if (x + s < VDG_ACTIVE_WIDTH)
                        vdg->line_buffer[x + s] = color;
                }
            }
        }
    } else {
        // 1 bit per pixel, 2 colors
        uint8_t fg, bg;
        if (css) {
            fg = VDG_COLOR_BRIGHT_ORANGE;
            bg = VDG_COLOR_DARK_ORANGE;
        } else {
            fg = VDG_COLOR_GREEN;
            bg = VDG_COLOR_DARK_GREEN;
        }
        int scale = 256 / info.width;  // 1 for RG6, 2 for others

        for (int byte_idx = 0; byte_idx < info.bytes_per_row; byte_idx++) {
            uint8_t b = row_data[byte_idx];
            for (int bit = 7; bit >= 0; bit--) {
                uint8_t color = (b & (1 << bit)) ? fg : bg;
                int x = (byte_idx * 8 + (7 - bit)) * scale;
                for (int s = 0; s < scale; s++) {
                    if (x + s < VDG_ACTIVE_WIDTH)
                        vdg->line_buffer[x + s] = color;
                }
            }
        }
    }
}

// ============================================================
// Main render entry point
// ============================================================

bool mc6847_render_scanline(MC6847* vdg) {
    if (!vdg->vram) {
        return false;
    }

    int active_line = vdg->scanline;
    if (active_line < 0 || active_line >= VDG_ACTIVE_HEIGHT) {
        return false;
    }

    if (vdg->mode & VDG_AG) {
        // Graphics mode
        render_graphics_scanline(vdg, active_line);
    } else {
        // Text/semigraphics mode
        render_text_scanline(vdg, active_line);
    }

    return true;
}

bool mc6847_next_scanline(MC6847* vdg) {
    vdg->scanline++;

    if (vdg->scanline >= SCANLINES_PER_FRAME) {
        vdg->scanline = 0;
        vdg->fs = true;
        return true;
    }

    vdg->fs = false;
    return false;
}
